## sdkconfig.defaults.esp32s3
```kconfig
CONFIG_ESPTOOLPY_FLASHSIZE_16MB=y
CONFIG_ESPTOOLPY_FLASHMODE_QIO=y

CONFIG_ESP_DEFAULT_CPU_FREQ_MHZ_240=y

CONFIG_SPIRAM=y
CONFIG_SPIRAM_MODE_OCT=y
CONFIG_SPIRAM_SPEED_80M=y
CONFIG_SPIRAM_MALLOC_ALWAYSINTERNAL=512
CONFIG_SPIRAM_MALLOC_RESERVE_INTERNAL=65536
CONFIG_SPIRAM_MEMTEST=n
CONFIG_MBEDTLS_EXTERNAL_MEM_ALLOC=y

CONFIG_ESP32S3_INSTRUCTION_CACHE_32KB=y
CONFIG_ESP32S3_DATA_CACHE_LINE_64B=y

# 唤醒词走 esp-sr 内置 WakeNet9 模型，同一时间只能开一个：
# 多个 =y 会把多个模型一起打进 model 分区，而 afe_wake_word.cc 只认最后一个命中的
# ESP_WN_PREFIX，实际生效哪个不确定。
# 换回「你好小智」：CONFIG_SR_WN_WN9_NIHAOXIAOZHI_TTS=y（上游 S3 默认，必须带 _TTS 后缀）
# 换「小嘉小嘉」：CONFIG_SR_WN_WN9_XIAO3JIA1XIAO3JIA1_TTS3=y
# 注意 wn9_xiaoaitongxue 与真实小米设备同名，同屋可能互相唤醒
CONFIG_SR_WN_WN9_XIAO3JIA1XIAO3JIA1_TTS3=y

CONFIG_ESP_SYSTEM_EVENT_TASK_STACK_SIZE=4096
```
